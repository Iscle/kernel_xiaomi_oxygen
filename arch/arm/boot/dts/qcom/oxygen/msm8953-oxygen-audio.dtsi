/*
 * Copyright (c) 2015-2016, The Linux Foundation. All rights reserved.
 *
 * This program is free software; you can redistribute it and/or modify
 * it under the terms of the GNU General Public License version 2 and
 * only version 2 as published by the Free Software Foundation.
 *
 * This program is distributed in the hope that it will be useful,
 * but WITHOUT ANY WARRANTY; without even the implied warranty of
 * MERCHANTABILITY or FITNESS FOR A PARTICULAR PURPOSE.  See the
 * GNU General Public License for more details.
 */

 &int_codec {
  /delete-property/ qcom,cdc-us-euro-gpios;
 	qcom,msm-mbhc-hphl-swh = <1>;
 	qcom,msm-mbhc-gnd-swh = <1>;
 	qcom,msm-hs-micbias-type = "external";

 	qcom,msm-gpios =
 		"pri_i2s",
 		"quin_i2s",
 		"comp_gpio";
 	qcom,pinctrl-names =
 		"all_off",
 		"pri_i2s_act",
 		"quin_act",
 		"quin_pri_i2s_act",
 		"comp_gpio_act",
 		"comp_gpio_pri_i2s_act",
 		"comp_gpio_quin_act",
 		"comp_gpio_quin_pri_i2s_act";

 	pinctrl-names =
 		"all_off",
 		"pri_i2s_act",
 		"quin_act",
 		"quin_pri_i2s_act",
 		"comp_gpio_act",
 		"comp_gpio_pri_i2s_act",
 		"comp_gpio_quin_act",
 		"comp_gpio_quin_pri_i2s_act";

 	pinctrl-2 = <&cdc_pdm_lines_sus &cdc_pdm_comp_lines_sus
 		&cdc_pdm_lines_2_sus &cross_conn_det_sus
 		&pri_tlmm_lines_act &pri_tlmm_ws_act>;
 	pinctrl-3 = <&cdc_pdm_lines_act &cdc_pdm_comp_lines_sus
 		&cdc_pdm_lines_2_act &cross_conn_det_sus
 		&pri_tlmm_lines_act &pri_tlmm_ws_act>;
 	pinctrl-4 = <&cdc_pdm_lines_sus &cdc_pdm_comp_lines_act
 		&cdc_pdm_lines_2_sus &cross_conn_det_sus
 		&pri_tlmm_lines_sus &pri_tlmm_ws_sus>;
 	pinctrl-5 = <&cdc_pdm_lines_act &cdc_pdm_comp_lines_act
 		&cdc_pdm_lines_2_act &cross_conn_det_sus
 		&pri_tlmm_lines_sus &pri_tlmm_ws_sus>;
 	pinctrl-6 = <&cdc_pdm_lines_sus &cdc_pdm_comp_lines_act
 		&cdc_pdm_lines_2_sus &cross_conn_det_sus
 		&pri_tlmm_lines_act &pri_tlmm_ws_act>;
 	pinctrl-7 = <&cdc_pdm_lines_act &cdc_pdm_comp_lines_act
 		&cdc_pdm_lines_2_act &cross_conn_det_sus
 		&pri_tlmm_lines_act &pri_tlmm_ws_act>;

  /delete-property/ pinctrl-8;
  /delete-property/ pinctrl-9;
  /delete-property/ pinctrl-10;
  /delete-property/ pinctrl-11;
  /delete-property/ pinctrl-12;
  /delete-property/ pinctrl-13;
  /delete-property/ pinctrl-14;
  /delete-property/ pinctrl-15;

 	asoc-codec = <&stub_codec>, <&pm8953_diangu_dig>;
 	asoc-codec-names = "msm-stub-codec.1", "cajon_codec";

  /delete-property/ asoc-wsa-codec-names;
  /delete-property/ asoc-wsa-codec-prefixes;

  /delete-property/ msm-vdd-wsa-switch-supply;
  /delete-property/ qcom,msm-vdd-wsa-switch-voltage;
  /delete-property/ qcom,msm-vdd-wsa-switch-current;
 };
